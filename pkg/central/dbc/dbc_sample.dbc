VERSION ""

NS_ :

BS_:

BU_:

BO_ 2364539902 EEC2: 8 Vector__XXX
 SG_ Accelerator_Pedal_1_Low_Idle_Swi : 0|2@1+ (1,0) [0|3] "bit" Vector__XXX

CM_ BO_ 2364539902 "Electronic Engine Controller 2";
CM_ SG_ 2364539902 Accelerator_Pedal_1_Low_Idle_Swi "Switch signal which indicates the state of the accelerator pedal 1 low idle switch.  The low idle switch is defined in SAE Recommended Practice J1843.";

BA_DEF_ SG_  "SPN" INT 0 524287;
BA_DEF_ SG_  "SystemSignalLongSymbol" STRING ;

BA_DEF_DEF_  "SPN" 0;
BA_DEF_DEF_  "SystemSignalLongSymbol" "";

BA_ "SPN" SG_ 2364539902 Accelerator_Pedal_1_Low_Idle_Swi 558;
BA_ "SystemSignalLongSymbol" SG_ 2364539902 Accelerator_Pedal_1_Low_Idle_Swi "A1IS";

VAL_ 2364539902 Accelerator_Pedal_1_Low_Idle_Swi 0 "Accelerator pedal 1 not in low idle condition" 1 "Accelerator pedal 1 in low idle condition" 2 "Error" 3 "Not available" ;
